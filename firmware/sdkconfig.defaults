## firmware/sdkconfig.defaults
```kconfig
# Target
CONFIG_IDF_TARGET="esp32p4"
CONFIG_ESP32P4_REV_MIN_1=y
CONFIG_IDF_EXPERIMENTAL_FEATURES=y

# Flash
CONFIG_ESPTOOLPY_FLASHMODE_QIO=y
CONFIG_ESPTOOLPY_FLASHSIZE_16MB=y

# PSRAM
CONFIG_SPIRAM=y
CONFIG_SPIRAM_SPEED_200M=y
CONFIG_SPIRAM_XIP_FROM_PSRAM=y

# Cache
CONFIG_CACHE_L2_CACHE_256KB=y
CONFIG_CACHE_L2_CACHE_LINE_128B=y

# MIPI DSI
CONFIG_LCD_RGB_ISR_IRAM_SAFE=y

# FreeRTOS
CONFIG_FREERTOS_HZ=1000

# Main task
CONFIG_ESP_MAIN_TASK_STACK_SIZE=10240

# Heap
CONFIG_SPIRAM_MALLOC_ALWAYSINTERNAL=4096
CONFIG_SPIRAM_ALLOW_STACK_EXTERNAL_MEMORY=y

# Console on default UART (CH343 USB-to-UART bridge) at 921600
CONFIG_ESP_CONSOLE_UART_DEFAULT=y
CONFIG_ESP_CONSOLE_UART_BAUDRATE=921600

# Halt on panic (don't reboot loop)
CONFIG_ESP_SYSTEM_PANIC_PRINT_HALT=y

# Log level
CONFIG_LOG_DEFAULT_LEVEL_INFO=y

# Compiler
CONFIG_COMPILER_OPTIMIZATION_PERF=y

# Partition table
CONFIG_PARTITION_TABLE_SINGLE_APP_LARGE=y
```
